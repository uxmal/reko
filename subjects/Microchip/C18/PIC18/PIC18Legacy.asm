;;; Segment CODE_00 (00000000)

;; _reset: 00000000
_reset proc
	GOTO	0x00013A
000004             12 00 00 00                             ....       

;; IT_low: 000008
IT_low proc
	GOTO	0x0000FC
00000C                                     12 00                   .. 

;; _do_cinit: 00000E
_do_cinit proc
	MOVLW	0x06
	MOVWF	TBLPTRL,ACCESS
	MOVLW	0x00
	MOVWF	TBLPTRH,ACCESS
	MOVLW	0x00
	MOVWF	TBLPTRU,ACCESS
	MOVLB	0x00
	TBLRD	*+
	MOVF	TABLAT,W,ACCESS
	MOVWF	0xC5,BANKED
	TBLRD	*+
	MOVF	TABLAT,W,ACCESS
	MOVWF	0xC6,BANKED

l000028:
	BNZ	0x000030

l00002A:
	TSTFSZ	0xC5,BANKED

l00002C:
	BRA	0x000030

l00002E:
	BRA	0x0000AA

l000030:
	TBLRD	*+
	MOVF	TABLAT,W,ACCESS
	MOVWF	0xC0,BANKED
	TBLRD	*+
	MOVF	TABLAT,W,ACCESS
	MOVWF	0xC1,BANKED
	TBLRD	*+
	MOVF	TABLAT,W,ACCESS
	MOVWF	0xC2,BANKED
	TBLRD	*+
	TBLRD	*+
	MOVF	TABLAT,W,ACCESS
	MOVWF	FSR0L,ACCESS
	TBLRD	*+
	MOVF	TABLAT,W,ACCESS
	MOVWF	FSR0H,ACCESS
	TBLRD	*+
	TBLRD	*+
	TBLRD	*+
	MOVF	TABLAT,W,ACCESS
	MOVWF	0xC3,BANKED
	TBLRD	*+
	MOVF	TABLAT,W,ACCESS
	MOVWF	0xC4,BANKED
	TBLRD	*+
	TBLRD	*+
	MOVFF	TBLPTRL,0x0C7
	MOVFF	TBLPTRH,0x0C8
	MOVFF	TBLPTRU,0x0C9
	MOVFF	0x0C0,TBLPTRL
	MOVFF	0x0C1,TBLPTRH
	MOVFF	0x0C2,TBLPTRU
	MOVLB	0x00
	MOVF	0xC3,F,BANKED

l000080:
	BNZ	0x000086

l000082:
	MOVF	0xC4,F,BANKED
	BZ	0x000094

l000086:
	TBLRD	*+
	MOVF	TABLAT,W,ACCESS
	MOVWF	POSTINC0,ACCESS
	DECF	0xC3,F,BANKED
	BC	0x000080

l000090:
	DECF	0xC4,F,BANKED
	BRA	0x000086

l000094:
	MOVFF	0x0C7,TBLPTRL
	MOVFF	0x0C8,TBLPTRH
	MOVFF	0x0C9,TBLPTRU
	MOVLB	0x00
	DECF	0xC5,F,BANKED
	MOVLW	0x00
	SUBWFB	0xC6,F,BANKED
	BRA	0x000028

l0000AA:
	RETURN

;; main: 000000AC
main proc
	MOVLB	0x00
	CLRF	0xCA,BANKED
	MOVLW	0x20
	MOVWF	INTCON,ACCESS
	MOVLW	0x84
	MOVWF	INTCON2,ACCESS
	BSF	RCON,IPEN,ACCESS
	CLRF	TMR0H,ACCESS
	CLRF	TMR0L,ACCESS
	MOVLW	0x82
	MOVWF	T0CON,ACCESS
	BSF	INTCON,GIE_GIEH,ACCESS
	CLRF	TRISB,ACCESS
	MOVLW	0x01
	MOVWF	POSTINC1,ACCESS
	RCALL	0x0000D0
	MOVF	POSTDEC1,F,ACCESS
	RETURN

;; doloop: 0000D0
doloop proc
	MOVFF	FSR2L,POSTINC1
	MOVFF	FSR1L,FSR2L

l0000D8:
	MOVLW	0xFE
	MOVF	PLUSW2,W,ACCESS
	BZ	0x0000F4

l0000DE:
	MOVLB	0x00
	BTFSS	0xCA,0,BANKED

l0000E2:
	BRA	0x0000F2

l0000E4:
	BCF	0xCA,0,BANKED
	MOVF	LATB,W,ACCESS
	ANDLW	0x01
	BZ	0x0000F0

l0000EC:
	BSF	LATB,LATB7,ACCESS
	BRA	0x0000F2

l0000F0:
	BCF	LATB,LATB7,ACCESS

l0000F2:
	BRA	0x0000D8

l0000F4:
	MOVF	POSTDEC1,F,ACCESS
	MOVFF	INDF1,FSR2L
	RETURN

l0000FC:
	MOVFF	FSR2H,PREINC1
	MOVFF	FSR1H,FSR2H
	MOVF	POSTINC1,F,ACCESS
	BTFSS	INTCON,TMR0IF,ACCESS

l000108:
	BRA	0x000112

l00010A:
	BCF	INTCON,TMR0IF,ACCESS
	MOVLB	0x00
	BSF	0xCA,0,BANKED
	BTG	LATB,LATB0,ACCESS

l000112:
	MOVF	POSTDEC1,F,ACCESS
	MOVFF	POSTDEC1,FSR2H
	RETFIE,	FAST

;; __zero_memory: 0000011A
__zero_memory proc
	MOVLW	0x00
	MOVWF	PRODL,ACCESS
	LFSR	FSR0,0x0000
	MOVLW	0x01
	RCALL	0x000128
	RETURN

;; zero_block: 000128
zero_block proc
	CPFSLT	FSR0H,ACCESS

l00012A:
	BRA	0x000130

l00012C:
	CLRF	POSTINC0,ACCESS
	BRA	0x000128

l000130:
	MOVF	PRODL,W,ACCESS

l000132:
	CPFSLT	FSR0L,ACCESS

l000134:
	RETURN

l000136:
	CLRF	POSTINC0,ACCESS
	BRA	0x000132

l00013A:
	LFSR	FSR1,0x0080
	LFSR	FSR2,0x0080
	CLRF	TBLPTRU,ACCESS
	BCF	0x01,6,ACCESS
	CALL	0x00000E
	CALL	0x000156
	CALL	0x0000AC
	BRA	0x00014A
	RETURN

;; __init: 000156
__init proc
	RETURN
;;; Segment CODE_01 (00300001)
00300001    C2                                            .             

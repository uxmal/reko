 #pragma read_only_file;
    #pragma pack( push, 1 )
typedef int             BOOL;
typedef unsigned char   BYTE;
typedef unsigned short  WORD;
typedef unsigned long   DWORD;
typedef unsigned int    UINT;
typedef BYTE __near       *PBYTE;
typedef BYTE __far        *LPBYTE;
typedef int __near        *PINT;
typedef int __far         *LPINT;
typedef WORD __near       *PWORD;
typedef WORD __far        *LPWORD;
typedef long __near       *PLONG;
typedef long __far        *LPLONG;
typedef DWORD __near      *PDWORD;
typedef DWORD __far       *LPDWORD;
typedef void __far        *LPVOID;
typedef UINT WPARAM;
typedef long LPARAM;
typedef long LRESULT;
typedef char __near       *PSTR;
typedef char __near       *NPSTR;
typedef char __far        *LPSTR;
typedef const char __far  *LPCSTR;
typedef UINT                        HANDLE;
typedef UINT HSTR;
typedef UINT HINSTANCE;
typedef UINT HTASK;
typedef UINT HDC;
typedef UINT HBITMAP;
typedef UINT HPEN;
typedef UINT HBRUSH;
typedef UINT HRGN;
typedef UINT HPALETTE;
typedef UINT HFONT;
typedef UINT HWND;
typedef UINT HRSRC;
typedef UINT HMETAFILE;
typedef UINT HMENU;
typedef UINT HICON;
typedef UINT HACCEL;
typedef UINT HDWP;
typedef DWORD HHOOK;
typedef UINT HDRVR;
typedef HANDLE      *PHANDLE;
typedef HANDLE __near *SPHANDLE;
typedef HANDLE __far  *LPHANDLE;
typedef HANDLE      HGLOBAL;
typedef HANDLE      HLOCAL;
typedef HANDLE      GLOBALHANDLE;
typedef HANDLE      LOCALHANDLE;
typedef UINT        ATOM;
typedef HINSTANCE   HMODULE;
typedef HICON       HCURSOR;
typedef int         HFILE;
typedef int (__far __pascal       *FARPROC)();
typedef int (__near __pascal    *NEARPROC)();
typedef struct tagRECT {
    int left;
    int top;
    int right;
    int bottom;
} RECT;
typedef RECT        *PRECT;
typedef RECT __near   *NPRECT;
typedef RECT __far    *LPRECT;
typedef struct tagPOINT {
    int x;
    int y;
} POINT;
typedef POINT       *PPOINT;
typedef POINT __near  *NPPOINT;
typedef POINT __far   *LPPOINT;
typedef struct tagSIZE {
    int cx;
    int cy;
} SIZE;
typedef SIZE        *PSIZE;
typedef SIZE __near   *NPSIZE;
typedef SIZE __far    *LPSIZE;
typedef struct tagWINDEBUGINFO {
    UINT    flags;
    DWORD   dwOptions;
    DWORD   dwFilter;
    char    achAllocModule[8];
    DWORD   dwAllocBreak;
    DWORD   dwAllocCount;
} WINDEBUGINFO;
typedef int     CATCHBUF[9];
typedef int __far *LPCATCHBUF;
typedef struct tagSEGINFO {
    UINT    offSegment;
    UINT    cbSegment;
    UINT    flags;
    UINT    cbAlloc;
    HGLOBAL h;
    UINT    alignShift;
    UINT    reserved[2];
} SEGINFO;
typedef SEGINFO __far *LPSEGINFO;
typedef FARPROC GNOTIFYPROC;
typedef struct tagOFSTRUCT {
    BYTE    cBytes;
    BYTE    fFixedDisk;
    UINT    nErrCode;
    BYTE    reserved[4];
    char    szPathName[128];
} OFSTRUCT;
typedef OFSTRUCT        *POFSTRUCT;
typedef OFSTRUCT __near   *NPOFSTRUCT;
typedef OFSTRUCT __far    *LPOFSTRUCT;
typedef FARPROC RSRCHDLRPROC;
int __far __pascal          AccessResource( HINSTANCE, HRSRC );
HGLOBAL __far __pascal      AllocResource( HINSTANCE, HRSRC, DWORD );
int __far __pascal          Catch( int __far * );
void __far __pascal         DebugBreak( void );
void __far __pascal         DirectedYield( HTASK );
void __far __pascal         FatalAppExit( UINT, LPCSTR );
void __far __pascal         FatalExit( int );
HRSRC __far __pascal        FindResource( HINSTANCE, LPCSTR, LPCSTR );
void __far __pascal         FreeLibrary( HINSTANCE );
BOOL __far __pascal         FreeModule( HINSTANCE );
void __far __pascal         FreeProcInstance( FARPROC );
BOOL __far __pascal         FreeResource( HGLOBAL );
HGLOBAL __far __pascal      GetCodeHandle( FARPROC );
void __far __pascal         GetCodeInfo( FARPROC, SEGINFO __far * );
UINT __far __pascal         GetCurrentPDB( void );
HTASK __far __pascal        GetCurrentTask( void );
LPSTR __far __pascal        GetDOSEnvironment( void );
UINT __far __pascal         GetDriveType( int );
DWORD __far __pascal        GetFreeSpace( UINT );
int __far __pascal          GetInstanceData( HINSTANCE, BYTE __near *, int );
int __far __pascal          GetModuleFileName( HINSTANCE, LPSTR, int );
HMODULE __far __pascal      GetModuleHandle( LPCSTR );
int __far __pascal          GetModuleUsage( HINSTANCE );
UINT __far __pascal         GetNumTasks( void );
UINT __far __pascal         GetPrivateProfileInt( LPCSTR, LPCSTR, int, LPCSTR );
int __far __pascal          GetPrivateProfileString( LPCSTR, LPCSTR, LPCSTR, LPSTR, int, LPCSTR );
FARPROC __far __pascal      GetProcAddress( HINSTANCE, LPCSTR );
UINT __far __pascal         GetProfileInt( LPCSTR, LPCSTR, int );
int __far __pascal          GetProfileString( LPCSTR, LPCSTR, LPCSTR, LPSTR, int );
UINT __far __pascal         GetSystemDirectory( LPSTR, UINT );
BYTE __far __pascal         GetTempDrive( char );
int __far __pascal          GetTempFileName( BYTE, LPCSTR, UINT, LPSTR );
DWORD __far __pascal        GetVersion( void );
DWORD __far __pascal        GetWinFlags( void );
UINT __far __pascal         GetWindowsDirectory( LPSTR, UINT );
HINSTANCE __far __pascal    LoadLibrary( LPCSTR );
HINSTANCE __far __pascal    LoadModule( LPCSTR, LPVOID );
HGLOBAL __far __pascal      LoadResource( HINSTANCE, HRSRC );
FARPROC __far __pascal      MakeProcInstance( FARPROC, HINSTANCE );
void __far __pascal         OutputDebugString( LPCSTR );
UINT __far __pascal         SetErrorMode( UINT );
RSRCHDLRPROC __far __pascal SetResourceHandler( HINSTANCE, LPCSTR, RSRCHDLRPROC );
long __far __pascal         SetSwapAreaSize( UINT );
DWORD __far __pascal        SizeofResource( HINSTANCE, HRSRC );
void __far __pascal         SwapRecording( UINT );
void __far __pascal         SwitchStackBack( void );
void __far __pascal         SwitchStackTo( UINT, UINT, UINT );
void __far __pascal         Throw( const int __far *, int );
void __far __pascal         ValidateCodeSegments( void );
UINT __far __pascal         WinExec( LPCSTR, UINT );
BOOL __far __pascal         WritePrivateProfileString( LPCSTR, LPCSTR, LPCSTR, LPCSTR );
BOOL __far __pascal         WriteProfileString( LPCSTR, LPCSTR, LPCSTR );
void __far __pascal         Yield( void );
char __far * __far __pascal   LockResource( HGLOBAL );
UINT __far __pascal         AllocDStoCSAlias( UINT );
UINT __far __pascal         AllocSelector( UINT );
UINT __far __pascal         FreeSelector( UINT );
DWORD __far __pascal        GetSelectorBase( UINT );
DWORD __far __pascal        GetSelectorLimit( UINT );
HGLOBAL __far __pascal      GlobalAlloc( UINT, DWORD );
DWORD __far __pascal        GlobalCompact( DWORD );
DWORD __far __pascal        GlobalDosAlloc( DWORD );
UINT __far __pascal         GlobalDosFree( UINT );
void __far __pascal         GlobalFix( HGLOBAL );
UINT __far __pascal         GlobalFlags( HGLOBAL );
HGLOBAL __far __pascal      GlobalFree( HGLOBAL );
DWORD __far __pascal        GlobalHandle( UINT );
HGLOBAL __far __pascal      GlobalLRUNewest( HGLOBAL );
HGLOBAL __far __pascal      GlobalLRUOldest( HGLOBAL );
void __far __pascal         GlobalNotify( GNOTIFYPROC );
UINT __far __pascal         GlobalPageLock( HGLOBAL );
UINT __far __pascal         GlobalPageUnlock( HGLOBAL );
HGLOBAL __far __pascal      GlobalReAlloc( HGLOBAL, DWORD, UINT );
DWORD __far __pascal        GlobalSize( HGLOBAL );
BOOL __far __pascal         GlobalUnWire( HGLOBAL );
void __far __pascal         GlobalUnfix( HGLOBAL );
BOOL __far __pascal         GlobalUnlock( HGLOBAL );
void __far __pascal         LimitEmsPages( DWORD );
HLOCAL __far __pascal       LocalAlloc( UINT, UINT );
UINT __far __pascal         LocalCompact( UINT );
UINT __far __pascal         LocalFlags( HLOCAL );
HLOCAL __far __pascal       LocalFree( HLOCAL );
BOOL __far __pascal         LocalInit( UINT, UINT, UINT );
HLOCAL __far __pascal       LocalReAlloc( HLOCAL, UINT, UINT );
UINT __far __pascal         LocalShrink( HLOCAL, UINT );
UINT __far __pascal         LocalSize( HLOCAL );
BOOL __far __pascal         LocalUnlock( HLOCAL );
HGLOBAL __far __pascal      LockSegment( UINT );
UINT __far __pascal         PrestoChangoSelector( UINT, UINT );
UINT __far __pascal         SetHandleCount( UINT );
UINT __far __pascal         SetSelectorBase( UINT, DWORD );
UINT __far __pascal         SetSelectorLimit( UINT, DWORD );
void __far __pascal         UnlockSegment( UINT );
void __far __pascal         ValidateFreeSpaces( void );
char __far * __far __pascal   GlobalLock( HGLOBAL );
char __far * __far __pascal   GlobalWire( HGLOBAL );
char __near * __far __pascal  LocalLock( HLOCAL );
HLOCAL __far __pascal       LocalHandle( UINT );
HFILE __far __pascal        _lclose( HFILE );
HFILE __far __pascal        _lcreat( LPCSTR, int );
long __far __pascal         _llseek( HFILE, long, int );
HFILE __far __pascal        _lopen( LPCSTR, int );
UINT __far __pascal         _lread( HFILE, void __huge *, UINT );
UINT __far __pascal         _lwrite( HFILE, const void __huge *, UINT );
HFILE __far __pascal        OpenFile( LPCSTR, OFSTRUCT __far *, UINT );
ATOM __far __pascal         AddAtom( LPCSTR );
ATOM __far __pascal         DeleteAtom( ATOM );
ATOM __far __pascal         FindAtom( LPCSTR );
HLOCAL __far __pascal       GetAtomHandle( ATOM );
UINT __far __pascal         GetAtomName( ATOM, LPSTR, int );
BOOL __far __pascal         InitAtomTable( int );
LPSTR __far __pascal        lstrcat( LPSTR, LPCSTR );
LPSTR __far __pascal        lstrcpy( LPSTR, LPCSTR );
int __far __pascal          lstrlen( LPCSTR );
BOOL __far __pascal         IsBadCodePtr( FARPROC );
BOOL __far __pascal         IsBadHugeReadPtr( const void __huge *, DWORD );
BOOL __far __pascal         IsBadHugeWritePtr( void __huge *, DWORD );
BOOL __far __pascal         IsBadReadPtr( const void __far *, UINT );
BOOL __far __pascal         IsBadStringPtr( const void __far *, UINT );
BOOL __far __pascal         IsBadWritePtr( void __far *, UINT );
BOOL __far __pascal         IsTask( HTASK );
void __far __cdecl    DebugOutput( UINT, LPCSTR, ... );
BOOL __far __pascal         GetWinDebugInfo( WINDEBUGINFO __far * , UINT );
void __far __pascal         LogError( UINT, void __far * );
void __far __pascal         LogParamError( UINT, FARPROC, void __far* );
BOOL __far __pascal         SetWinDebugInfo( const WINDEBUGINFO __far * );
long __far __pascal         _hread( HFILE, void __huge *, long );
long __far __pascal         _hwrite( HFILE, const void __huge *, long );
void __far __pascal         hmemcpy( void __huge *, const void __huge *, long );
LPSTR __far __pascal        lstrcpyn( LPSTR, LPCSTR, int );
BOOL __far __pascal         IsDBCSLeadByte( BYTE );
void __far __pascal     AnsiToOem( const char __huge *, char __huge * );
void __far __pascal     AnsiToOemBuff( LPCSTR, LPSTR, UINT );
void __far __pascal     OemToAnsi( const char __huge *, char __huge * );
void __far __pascal     OemToAnsiBuff( LPCSTR, LPSTR, UINT );
int __far __pascal      GetKBCodePage( void );
int __far __pascal      GetKeyNameText( long, LPSTR, int );
int __far __pascal      GetKeyboardType( int );
UINT __far __pascal     MapVirtualKey( UINT, UINT );
DWORD __far __pascal    OemKeyScan( UINT );
int __far __pascal      ToAscii( UINT, UINT, BYTE __far *, DWORD __far *, UINT );
UINT __far __pascal     VkKeyScan(UINT);
LPSTR __far __pascal    AnsiLower( LPSTR );
UINT __far __pascal     AnsiLowerBuff( LPSTR, UINT );
LPSTR __far __pascal    AnsiNext( LPCSTR );
LPSTR __far __pascal    AnsiPrev( LPCSTR, LPCSTR );
LPSTR __far __pascal    AnsiUpper( LPSTR );
UINT __far __pascal     AnsiUpperBuff( LPSTR, UINT );
BOOL __far __pascal     ExitWindows( DWORD, UINT );
DWORD __far __pascal    GetCurrentTime( void );
DWORD __far __pascal    GetTickCount( void );
DWORD __far __pascal    GetTimerResolution( void );
int __far __pascal      LoadString( HINSTANCE, UINT, LPSTR, int );
UINT __far __pascal     WNetAddConnection( LPSTR, LPSTR, LPSTR );
UINT __far __pascal     WNetCancelConnection( LPSTR, BOOL );
UINT __far __pascal     WNetGetConnection( LPSTR, LPSTR, UINT __far * );
ATOM __far __pascal     GlobalAddAtom( LPCSTR );
ATOM __far __pascal     GlobalDeleteAtom( ATOM );
ATOM __far __pascal     GlobalFindAtom( LPCSTR );
UINT __far __pascal     GlobalGetAtomName( ATOM, LPSTR, int );
BOOL __far __pascal     IsCharAlpha( char );
BOOL __far __pascal     IsCharAlphaNumeric( char );
BOOL __far __pascal     IsCharLower( char );
BOOL __far __pascal     IsCharUpper( char );
int __far __pascal      lstrcmp( LPCSTR, LPCSTR );
int __far __pascal      lstrcmpi( LPCSTR, LPCSTR );
BOOL __far __pascal     ExitWindowsExec( LPCSTR, LPCSTR );
UINT __far __pascal     GetFreeSystemResources( UINT );
int __far __pascal  ProfInsChk( void );
void __far __pascal ProfSetup( int, int );
void __far __pascal ProfSampRate( int, int );
void __far __pascal ProfStart( void );
void __far __pascal ProfStop( void );
void __far __pascal ProfClear( void );
void __far __pascal ProfFlush( void );
void __far __pascal ProfFinish( void );
typedef UINT HGDIOBJ;
typedef DWORD   COLORREF;
typedef FARPROC GOBJENUMPROC;
typedef struct tagLOGPEN {
    UINT        lopnStyle;
    POINT       lopnWidth;
    COLORREF    lopnColor;
} LOGPEN;
typedef LOGPEN      *PLOGPEN;
typedef LOGPEN __near *NPLOGPEN;
typedef LOGPEN __far  *LPLOGPEN;
typedef struct tagLOGBRUSH {
    UINT        lbStyle;
    COLORREF    lbColor;
    int         lbHatch;
} LOGBRUSH;
typedef LOGBRUSH        *PLOGBRUSH;
typedef LOGBRUSH __near   *NPLOGBRUSH;
typedef LOGBRUSH __far    *LPLOGBRUSH;
typedef LOGBRUSH        PATTERN;
typedef PATTERN         *PPATTERN;
typedef PATTERN __near    *NPPATTERN;
typedef PATTERN __far     *LPPATTERN;
typedef struct tagPALETTEENTRY {
    BYTE    peRed;
    BYTE    peGreen;
    BYTE    peBlue;
    BYTE    peFlags;
} PALETTEENTRY;
typedef PALETTEENTRY __far    *LPPALETTEENTRY;
typedef struct tagLOGPALETTE {
    WORD            palVersion;
    WORD            palNumEntries;
    PALETTEENTRY    palPalEntry[1];
} LOGPALETTE;
typedef LOGPALETTE      *PLOGPALETTE;
typedef LOGPALETTE __near *NPLOGPALETTE;
typedef LOGPALETTE __far  *LPLOGPALETTE;
typedef FARPROC LINEDDAPROC;
typedef FARPROC GRAYSTRINGPROC;
typedef struct tagLOGFONT {
    int     lfHeight;
    int     lfWidth;
    int     lfEscapement;
    int     lfOrientation;
    int     lfWeight;
    BYTE    lfItalic;
    BYTE    lfUnderline;
    BYTE    lfStrikeOut;
    BYTE    lfCharSet;
    BYTE    lfOutPrecision;
    BYTE    lfClipPrecision;
    BYTE    lfQuality;
    BYTE    lfPitchAndFamily;
    char    lfFaceName[32];
} LOGFONT;
typedef LOGFONT         *PLOGFONT;
typedef LOGFONT __near    *NPLOGFONT;
typedef LOGFONT __far     *LPLOGFONT;
typedef struct tagTEXTMETRIC {
    int     tmHeight;
    int     tmAscent;
    int     tmDescent;
    int     tmInternalLeading;
    int     tmExternalLeading;
    int     tmAveCharWidth;
    int     tmMaxCharWidth;
    int     tmWeight;
    BYTE    tmItalic;
    BYTE    tmUnderlined;
    BYTE    tmStruckOut;
    BYTE    tmFirstChar;
    BYTE    tmLastChar;
    BYTE    tmDefaultChar;
    BYTE    tmBreakChar;
    BYTE    tmPitchAndFamily;
    BYTE    tmCharSet;
    int     tmOverhang;
    int     tmDigitizedAspectX;
    int     tmDigitizedAspectY;
} TEXTMETRIC;
typedef TEXTMETRIC      *PTEXTMETRIC;
typedef TEXTMETRIC __near *NPTEXTMETRIC;
typedef TEXTMETRIC __far  *LPTEXTMETRIC;
typedef struct tagPANOSE {
    BYTE    bFamilyType;
    BYTE    bSerifStyle;
    BYTE    bWeight;
    BYTE    bProportion;
    BYTE    bContrast;
    BYTE    bStrokeVariation;
    BYTE    bArmStyle;
    BYTE    bLetterform;
    BYTE    bMidline;
    BYTE    bXHeight;
} PANOSE;
typedef PANOSE __far  *LPPANOSE;
typedef struct tagOUTLINETEXTMETRIC {
    UINT        otmSize;
    TEXTMETRIC  otmTextMetrics;
    BYTE        otmFiller;
    PANOSE      otmPanoseNumber;
    UINT        otmfsSelection;
    UINT        otmfsType;
    int         otmsCharSlopeRise;
    int         otmsCharSlopeRun;
    int         otmItalicAngle;
    UINT        otmEMSquare;
    int         otmAscent;
    int         otmDescent;
    UINT        otmLineGap;
    UINT        otmsCapEmHeight;
    UINT        otmsXHeight;
    RECT        otmrcFontBox;
    int         otmMacAscent;
    int         otmMacDescent;
    UINT        otmMacLineGap;
    UINT        otmusMinimumPPEM;
    POINT       otmptSubscriptSize;
    POINT       otmptSubscriptOffset;
    POINT       otmptSuperscriptSize;
    POINT       otmptSuperscriptOffset;
    UINT        otmsStrikeoutSize;
    int         otmsStrikeoutPosition;
    int         otmsUnderscorePosition;
    int         otmsUnderscoreSize;
    PSTR        otmpFamilyName;
    PSTR        otmpFaceName;
    PSTR        otmpStyleName;
    PSTR        otmpFullName;
} OUTLINETEXTMETRIC;
typedef OUTLINETEXTMETRIC __far   *LPOUTLINETEXTMETRIC;
typedef struct tagNEWTEXTMETRIC {
    int     tmHeight;
    int     tmAscent;
    int     tmDescent;
    int     tmInternalLeading;
    int     tmExternalLeading;
    int     tmAveCharWidth;
    int     tmMaxCharWidth;
    int     tmWeight;
    BYTE    tmItalic;
    BYTE    tmUnderlined;
    BYTE    tmStruckOut;
    BYTE    tmFirstChar;
    BYTE    tmLastChar;
    BYTE    tmDefaultChar;
    BYTE    tmBreakChar;
    BYTE    tmPitchAndFamily;
    BYTE    tmCharSet;
    int     tmOverhang;
    int     tmDigitizedAspectX;
    int     tmDigitizedAspectY;
    DWORD   ntmFlags;
    UINT    ntmSizeEM;
    UINT    ntmCellHeight;
    UINT    ntmAvgWidth;
} NEWTEXTMETRIC;
typedef NEWTEXTMETRIC       *PNEWTEXTMETRIC;
typedef NEWTEXTMETRIC __near  *NPNEWTEXTMETRIC;
typedef NEWTEXTMETRIC __far   *LPNEWTEXTMETRIC;
typedef struct tagENUMLOGFONT {
    LOGFONT elfLogFont;
    char    elfFullName[64];
    char    elfStyle[32];
} ENUMLOGFONT;
typedef ENUMLOGFONT __far *LPENUMLOGFONT;
typedef FARPROC OLDFONTENUMPROC;
typedef FARPROC FONTENUMPROC;
typedef struct tagGLYPHMETRICS {
    UINT    gmBlackBoxX;
    UINT    gmBlackBoxY;
    POINT   gmptGlyphOrigin;
    int     gmCellIncX;
    int     gmCellIncY;
} GLYPHMETRICS;
typedef GLYPHMETRICS __far    *LPGLYPHMETRICS;
typedef struct tagFIXED {
    UINT    fract;
    int     value;
} FIXED;
typedef FIXED __far   *LPFIXED;
typedef struct tagMAT2 {
    FIXED   eM11;
    FIXED   eM12;
    FIXED   eM21;
    FIXED   eM22;
} MAT2;
typedef FIXED __far   *LPMAT2;
typedef struct tagPOINTFX {
    FIXED   x;
    FIXED   y;
} POINTFX;
typedef POINTFX __far *LPPOINTFX;
typedef struct tagTTPOLYCURVE {
    UINT    wType;
    UINT    cpfx;
    POINTFX apfx[1];
} TTPOLYCURVE;
typedef TTPOLYCURVE __far *LPTTPOLYCURVE;
typedef struct tagTTPOLYGONHEADER {
    DWORD   cb;
    DWORD   dwType;
    POINTFX pfxStart;
} TTPOLYGONHEADER;
typedef TTPOLYGONHEADER __far *LPTTPOLYGONHEADER;
typedef struct tagABC {
    int     abcA;
    UINT    abcB;
    int     abcC;
} ABC;
typedef ABC __far *LPABC;
typedef struct tagKERNINGPAIR {
    WORD    wFirst;
    WORD    wSecond;
    int     iKernAmount;
} KERNINGPAIR;
typedef KERNINGPAIR __far *LPKERNINGPAIR;
typedef struct tagRASTERIZER_STATUS {
    int nSize;
    int wFlags;
    int nLanguageID;
} RASTERIZER_STATUS;
typedef RASTERIZER_STATUS __far   *LPRASTERIZER_STATUS;
typedef struct tagBITMAP {
    int         bmType;
    int         bmWidth;
    int         bmHeight;
    int         bmWidthBytes;
    BYTE        bmPlanes;
    BYTE        bmBitsPixel;
    void __far    *bmBits;
} BITMAP;
typedef BITMAP      *PBITMAP;
typedef BITMAP __near *NPBITMAP;
typedef BITMAP __far  *LPBITMAP;
typedef struct tagRGBTRIPLE {
    BYTE    rgbtBlue;
    BYTE    rgbtGreen;
    BYTE    rgbtRed;
} RGBTRIPLE;
typedef RGBTRIPLE __far   *LPRGBTRIPLE;
typedef struct tagRGBQUAD {
    BYTE    rgbBlue;
    BYTE    rgbGreen;
    BYTE    rgbRed;
    BYTE    rgbReserved;
} RGBQUAD;
typedef RGBQUAD __far *LPRGBQUAD;
typedef struct tagBITMAPCOREHEADER {
    DWORD   bcSize;
    short   bcWidth;
    short   bcHeight;
    WORD    bcPlanes;
    WORD    bcBitCount;
} BITMAPCOREHEADER;
typedef BITMAPCOREHEADER        *PBITMAPCOREHEADER;
typedef BITMAPCOREHEADER __far    *LPBITMAPCOREHEADER;
typedef struct tagBITMAPINFOHEADER {
    DWORD   biSize;
    long    biWidth;
    long    biHeight;
    WORD    biPlanes;
    WORD    biBitCount;
    DWORD   biCompression;
    DWORD   biSizeImage;
    long    biXPelsPerMeter;
    long    biYPelsPerMeter;
    DWORD   biClrUsed;
    DWORD   biClrImportant;
} BITMAPINFOHEADER;
typedef BITMAPINFOHEADER        *PBITMAPINFOHEADER;
typedef BITMAPINFOHEADER __far    *LPBITMAPINFOHEADER;
typedef struct tagBITMAPINFO {
    BITMAPINFOHEADER    bmiHeader;
    RGBQUAD             bmiColors[1];
} BITMAPINFO;
typedef BITMAPINFO      *PBITMAPINFO;
typedef BITMAPINFO __far  *LPBITMAPINFO;
typedef struct tagBITMAPCOREINFO {
    BITMAPCOREHEADER    bmciHeader;
    RGBTRIPLE           bmciColors[1];
} BITMAPCOREINFO;
typedef BITMAPCOREINFO      *PBITMAPCOREINFO;
typedef BITMAPCOREINFO __far  *LPBITMAPCOREINFO;
typedef struct tagBITMAPFILEHEADER {
    UINT    bfType;
    DWORD   bfSize;
    UINT    bfReserved1;
    UINT    bfReserved2;
    DWORD   bfOffBits;
} BITMAPFILEHEADER;
typedef BITMAPFILEHEADER        *PBITMAPFILEHEADER;
typedef BITMAPFILEHEADER __far    *LPBITMAPFILEHEADER;
typedef struct tagMETAFILEPICT {
    int         mm;
    int         xExt;
    int         yExt;
    HMETAFILE   hMF;
} METAFILEPICT;
typedef METAFILEPICT __far    *LPMETAFILEPICT;
typedef struct tagMETAHEADER {
    UINT    mtType;
    UINT    mtHeaderSize;
    UINT    mtVersion;
    DWORD   mtSize;
    UINT    mtNoObjects;
    DWORD   mtMaxRecord;
    UINT    mtNoParameters;
} METAHEADER;
typedef struct tagHANDLETABLE {
    HGDIOBJ objectHandle[1];
} HANDLETABLE;
typedef HANDLETABLE     *PHANDLETABLE;
typedef HANDLETABLE __far *LPHANDLETABLE;
typedef struct tagMETARECORD {
    DWORD   rdSize;
    UINT    rdFunction;
    UINT    rdParm[1];
} METARECORD;
typedef METARECORD      *PMETARECORD;
typedef METARECORD __far  *LPMETARECORD;
typedef FARPROC MFENUMPROC;
typedef FARPROC ABORTPROC;
typedef struct {
    int     cbSize;
    LPCSTR  lpszDocName;
    LPCSTR  lpszOutput;
} DOCINFO;
typedef DOCINFO __far *LPDOCINFO;
void __far __pascal         AnimatePalette( HPALETTE, UINT, UINT, const PALETTEENTRY __far * );
BOOL __far __pascal         Arc( HDC, int, int, int, int, int, int, int, int );
BOOL __far __pascal         Chord( HDC, int, int, int, int, int, int, int, int );
int __far __pascal          CombineRgn( HRGN, HRGN, HRGN, int );
HDC __far __pascal          CreateCompatibleDC( HDC );
HDC __far __pascal          CreateDC( LPCSTR, LPCSTR, LPCSTR, const void __far * );
HRGN __far __pascal         CreateEllipticRgn( int, int, int, int );
HRGN __far __pascal         CreateEllipticRgnIndirect( const RECT __far * );
HDC __far __pascal          CreateIC( LPCSTR, LPCSTR, LPCSTR, const void __far * );
HPALETTE __far __pascal     CreatePalette( const LOGPALETTE __far * );
HRGN __far __pascal         CreatePolyPolygonRgn( const POINT __far *, const int __far *, int, int );
HRGN __far __pascal         CreatePolygonRgn( const POINT __far *, int, int );
HRGN __far __pascal         CreateRectRgn( int, int, int, int );
HRGN __far __pascal         CreateRectRgnIndirect( const RECT __far * );
HRGN __far __pascal         CreateRoundRectRgn( int, int, int, int, int, int );
BOOL __far __pascal         DPtoLP( HDC, POINT __far *, int );
BOOL __far __pascal         DeleteDC( HDC );
BOOL __far __pascal         Ellipse( HDC, int, int, int, int );
BOOL __far __pascal         EqualRgn( HRGN, HRGN );
int __far __pascal          Escape( HDC, int, int, LPCSTR, void __far * );
int __far __pascal          ExcludeClipRect( HDC, int, int, int, int );
BOOL __far __pascal         ExtFloodFill( HDC, int, int, COLORREF, UINT );
BOOL __far __pascal         ExtTextOut( HDC, int, int, UINT, const RECT __far *, LPCSTR, UINT, int __far * );
BOOL __far __pascal         FillRgn( HDC, HRGN, HBRUSH );
BOOL __far __pascal         FloodFill( HDC, int, int, COLORREF );
BOOL __far __pascal         FrameRgn( HDC, HRGN, HBRUSH, int, int );
COLORREF __far __pascal     GetBkColor( HDC );
int __far __pascal          GetBkMode( HDC );
BOOL __far __pascal         GetCharWidth( HDC, UINT, UINT, int __far * );
int __far __pascal          GetClipBox( HDC, RECT __far * );
DWORD __far __pascal        GetCurrentPosition( HDC );
DWORD __far __pascal        GetDCOrg( HDC );
int __far __pascal          GetDeviceCaps( HDC, int );
int __far __pascal          GetEnvironment( LPCSTR, void __far *, UINT );
int __far __pascal          GetMapMode( HDC );
COLORREF __far __pascal     GetNearestColor( HDC, COLORREF );
UINT __far __pascal         GetNearestPaletteIndex( HPALETTE, COLORREF );
UINT __far __pascal         GetPaletteEntries( HPALETTE, UINT, UINT, PALETTEENTRY __far * );
int __far __pascal          GetPolyFillMode( HDC );
int __far __pascal          GetRgnBox( HRGN, RECT __far * );
UINT __far __pascal         GetSystemPaletteEntries( HDC, UINT, UINT, PALETTEENTRY __far * );
UINT __far __pascal         GetSystemPaletteUse( HDC );
UINT __far __pascal         GetTextAlign( HDC );
int __far __pascal          GetTextCharacterExtra( HDC );
COLORREF __far __pascal     GetTextColor( HDC );
DWORD __far __pascal        GetTextExtent( HDC, LPCSTR, int );
DWORD __far __pascal        GetViewportExt( HDC );
DWORD __far __pascal        GetViewportOrg( HDC );
DWORD __far __pascal        GetWindowExt( HDC );
DWORD __far __pascal        GetWindowOrg( HDC );
int __far __pascal          IntersectClipRect( HDC, int, int, int, int );
BOOL __far __pascal         InvertRgn( HDC, HRGN );
BOOL __far __pascal         LPtoDP( HDC, POINT __far *, int );
void __far __pascal         LineDDA( int, int, int, int, LINEDDAPROC, LPARAM );
BOOL __far __pascal         LineTo( HDC, int, int );
DWORD __far __pascal        MoveTo( HDC, int, int );
int __far __pascal          MulDiv( int, int, int );
int __far __pascal          OffsetClipRgn( HDC, int, int );
int __far __pascal          OffsetRgn( HRGN, int, int );
DWORD __far __pascal        OffsetViewportOrg( HDC, int, int );
DWORD __far __pascal        OffsetWindowOrg( HDC, int, int );
BOOL __far __pascal         PaintRgn( HDC, HRGN );
BOOL __far __pascal         Pie( HDC, int, int, int, int, int, int, int, int );
BOOL __far __pascal         PolyPolygon( HDC, const POINT __far *, int __far *, int );
BOOL __far __pascal         Polygon( HDC, const POINT __far *, int );
BOOL __far __pascal         Polyline( HDC, const POINT __far *, int );
BOOL __far __pascal         PtInRegion( HRGN, int, int );
BOOL __far __pascal         PtVisible( HDC, int, int );
BOOL __far __pascal         QueryAbort( HDC, int );
UINT __far __pascal         RealizePalette( HDC );
BOOL __far __pascal         RectInRegion( HRGN, const RECT __far * );
BOOL __far __pascal         RectVisible( HDC, const RECT __far * );
BOOL __far __pascal         Rectangle( HDC, int, int, int, int );
BOOL __far __pascal         ResizePalette( HPALETTE, UINT );
BOOL __far __pascal         RestoreDC( HDC, int );
BOOL __far __pascal         RoundRect( HDC, int, int, int, int, int, int );
int __far __pascal          SaveDC( HDC );
DWORD __far __pascal        ScaleViewportExt( HDC, int, int, int, int );
DWORD __far __pascal        ScaleWindowExt( HDC, int, int, int, int );
int __far __pascal          SelectClipRgn( HDC, HRGN );
HPALETTE __far __pascal     SelectPalette( HDC, HPALETTE, BOOL );
COLORREF __far __pascal     SetBkColor( HDC, COLORREF );
int __far __pascal          SetBkMode( HDC, int );
int __far __pascal          SetEnvironment( LPCSTR, const void __far *, UINT );
int __far __pascal          SetMapMode( HDC, int );
UINT __far __pascal         SetPaletteEntries( HPALETTE, UINT, UINT, const PALETTEENTRY __far * );
int __far __pascal          SetPolyFillMode( HDC, int );
void __far __pascal         SetRectRgn( HRGN, int, int, int, int );
UINT __far __pascal         SetSystemPaletteUse( HDC, UINT );
UINT __far __pascal         SetTextAlign( HDC, UINT );
int __far __pascal          SetTextCharacterExtra( HDC, int );
COLORREF __far __pascal     SetTextColor( HDC, COLORREF );
int __far __pascal          SetTextJustification( HDC, int, int );
DWORD __far __pascal        SetViewportExt( HDC, int, int );
DWORD __far __pascal        SetViewportOrg( HDC, int, int );
DWORD __far __pascal        SetWindowExt( HDC, int, int );
DWORD __far __pascal        SetWindowOrg( HDC, int, int );
BOOL __far __pascal         TextOut( HDC, int, int, LPCSTR, int );
int __far __pascal          AddFontResource( LPCSTR );
HBRUSH __far __pascal       CreateBrushIndirect( LOGBRUSH __far * );
HBRUSH __far __pascal       CreateDIBPatternBrush( HGLOBAL, UINT );
HFONT __far __pascal        CreateFont( int, int, int, int, int, BYTE, BYTE, BYTE, BYTE, BYTE, BYTE, BYTE, BYTE, LPCSTR );
HFONT __far __pascal        CreateFontIndirect( const LOGFONT __far * );
HBRUSH __far __pascal       CreateHatchBrush( int, COLORREF );
HBRUSH __far __pascal       CreatePatternBrush( HBITMAP );
HPEN __far __pascal         CreatePen( int, int, COLORREF );
HPEN __far __pascal         CreatePenIndirect( LOGPEN __far * );
HBRUSH __far __pascal       CreateSolidBrush( COLORREF );
BOOL __far __pascal         DeleteObject( HGDIOBJ );
DWORD __far __pascal        GetAspectRatioFilter( HDC );
DWORD __far __pascal        GetBrushOrg( HDC );
int __far __pascal          GetObject( HGDIOBJ, int, void __far * );
HGDIOBJ __far __pascal      GetStockObject( int );
int __far __pascal          GetTextFace( HDC, int, LPSTR );
BOOL __far __pascal         IsGDIObject( HGDIOBJ );
BOOL __far __pascal         RemoveFontResource( LPCSTR );
HGDIOBJ __far __pascal      SelectObject( HDC, HGDIOBJ );
DWORD __far __pascal        SetBrushOrg( HDC, int, int );
DWORD __far __pascal        SetMapperFlags( HDC, DWORD );
BOOL __far __pascal         UnrealizeObject( HGDIOBJ );
int __far __pascal          UpdateColors( HDC );
int __far __pascal          EnumObjects( HDC, int, GOBJENUMPROC, LPSTR );
BOOL __far __pascal         GetTextMetrics( HDC, TEXTMETRIC __far * );
int __far __pascal          EnumFonts( HDC, LPCSTR, OLDFONTENUMPROC, LPSTR );
BOOL __far __pascal         BitBlt( HDC, int, int, int, int, HDC, int, int, DWORD );
HBITMAP __far __pascal      CreateBitmap( int, int, UINT, UINT, const void __far * );
HBITMAP __far __pascal      CreateBitmapIndirect( BITMAP __far * );
HBITMAP __far __pascal      CreateCompatibleBitmap( HDC, int, int );
HBITMAP __far __pascal      CreateDIBitmap( HDC, BITMAPINFOHEADER __far *, DWORD, const void __far *, BITMAPINFO __far *, UINT );
HBITMAP __far __pascal      CreateDiscardableBitmap( HDC, int, int );
long __far __pascal         GetBitmapBits( HBITMAP, long, void __far * );
DWORD __far __pascal        GetBitmapDimension( HBITMAP );
int __far __pascal          GetDIBits( HDC, HBITMAP, UINT, UINT, void __far *, BITMAPINFO __far *, UINT );
COLORREF __far __pascal     GetPixel( HDC, int, int );
int __far __pascal          GetROP2( HDC );
int __far __pascal          GetStretchBltMode( HDC );
BOOL __far __pascal         PatBlt( HDC, int, int, int, int, DWORD );
long __far __pascal         SetBitmapBits( HBITMAP, DWORD, const void __far * );
DWORD __far __pascal        SetBitmapDimension( HBITMAP, int, int );
int __far __pascal          SetDIBits( HDC, HBITMAP, UINT, UINT, const void __far *, BITMAPINFO __far *, UINT );
int __far __pascal          SetDIBitsToDevice( HDC, int, int, int, int, int, int, UINT, UINT, void __far *, BITMAPINFO __far *, UINT );
COLORREF __far __pascal     SetPixel( HDC, int, int, COLORREF );
int __far __pascal          SetROP2( HDC, int );
int __far __pascal          SetStretchBltMode( HDC, int );
BOOL __far __pascal         StretchBlt( HDC, int, int, int, int, HDC, int, int, int, int, DWORD );
int __far __pascal          StretchDIBits( HDC, int, int, int, int, int, int, int, int, const void __far *, LPBITMAPINFO, UINT, DWORD );
HMETAFILE __far __pascal    CloseMetaFile( HDC );
HMETAFILE __far __pascal    CopyMetaFile( HMETAFILE, LPCSTR );
HDC __far __pascal          CreateMetaFile( LPCSTR );
BOOL __far __pascal         DeleteMetaFile(HMETAFILE);
BOOL __far __pascal         EnumMetaFile( HDC, HMETAFILE, MFENUMPROC, LPARAM );
HMETAFILE __far __pascal    GetMetaFile( LPCSTR );
HGLOBAL __far __pascal      GetMetaFileBits( HMETAFILE );
BOOL __far __pascal         PlayMetaFile( HDC, HMETAFILE );
void __far __pascal         PlayMetaFileRecord( HDC, HANDLETABLE __far *, METARECORD __far *, UINT );
HMETAFILE __far __pascal    SetMetaFileBits( HGLOBAL );
int __far __pascal          AbortDoc( HDC );
int __far __pascal          EndDoc( HDC );
int __far __pascal          EndPage( HDC );
UINT __far __pascal         GetBoundsRect( HDC, RECT __far *, UINT );
BOOL __far __pascal         GetCurrentPositionEx( HDC, POINT __far * );
BOOL __far __pascal         GetTextExtentPoint( HDC, LPCSTR, int, SIZE __far * );
BOOL __far __pascal         GetViewportExtEx( HDC, SIZE __far * );
BOOL __far __pascal         GetViewportOrgEx( HDC, POINT __far * );
BOOL __far __pascal         GetWindowExtEx( HDC, SIZE __far * );
BOOL __far __pascal         GetWindowOrgEx( HDC, POINT __far * );
BOOL __far __pascal         MoveToEx( HDC, int, int, POINT __far * );
BOOL __far __pascal         OffsetViewportOrgEx( HDC, int, int, POINT __far * );
BOOL __far __pascal         OffsetWindowOrgEx( HDC, int, int, POINT __far * );
BOOL __far __pascal         ScaleViewportExtEx( HDC, int, int, int, int, SIZE __far * );
BOOL __far __pascal         ScaleWindowExtEx( HDC, int, int, int, int, SIZE __far * );
int __far __pascal          SetAbortProc( HDC, ABORTPROC );
UINT __far __pascal         SetBoundsRect( HDC, const RECT __far *, UINT );
BOOL __far __pascal         SetViewportExtEx( HDC, int, int, SIZE __far * );
BOOL __far __pascal         SetViewportOrgEx( HDC, int, int, POINT __far * );
BOOL __far __pascal         SetWindowExtEx( HDC, int, int, SIZE __far * );
BOOL __far __pascal         SetWindowOrgEx( HDC, int, int, POINT __far * );
HANDLE __far __pascal       SpoolFile( LPSTR, LPSTR, LPSTR, LPSTR );
int __far __pascal          StartDoc( HDC, DOCINFO __far * );
int __far __pascal          StartPage( HDC );
BOOL __far __pascal         GetAspectRatioFilterEx( HDC, SIZE __far * );
BOOL __far __pascal         GetBrushOrgEx( HDC, POINT __far * );
WORD __far __pascal         GetOutlineTextMetrics( HDC, UINT, OUTLINETEXTMETRIC __far * );
int __far __pascal          EnumFontFamilies( HDC, LPCSTR, FONTENUMPROC, LPSTR );
BOOL __far __pascal         CreateScalableFontResource( UINT, LPCSTR, LPCSTR, LPCSTR );
BOOL __far __pascal         GetCharABCWidths( HDC, UINT, UINT, ABC __far * );
DWORD __far __pascal        GetFontData( HDC, DWORD, DWORD, void __far *, DWORD );
DWORD __far __pascal        GetGlyphOutline( HDC, UINT, UINT, GLYPHMETRICS __far *, DWORD, void __far *, const MAT2 __far * );
int __far __pascal          GetKerningPairs( HDC, int, KERNINGPAIR __far * );
BOOL __far __pascal         GetRasterizerCaps( RASTERIZER_STATUS __far *, int );
BOOL __far __pascal         GetBitmapDimensionEx( HBITMAP, SIZE __far * );
BOOL __far __pascal         SetBitmapDimensionEx( HBITMAP, int, int, SIZE __far * );
HMETAFILE __far __pascal    SetMetaFileBitsBetter( HGLOBAL );
void __far __pascal     DrawFocusRect( HDC, const RECT __far * );
int __far __pascal      FillRect( HDC, const RECT __far *, HBRUSH );
int __far __pascal      FrameRect( HDC, const RECT __far *, HBRUSH );
DWORD __far __pascal    GetTabbedTextExtent( HDC, LPCSTR, int, int, int __far * );
BOOL __far __pascal     GrayString( HDC, HBRUSH, GRAYSTRINGPROC, LPARAM, int, int, int, int, int );
void __far __pascal     InvertRect( HDC, const RECT __far * );
long __far __pascal     TabbedTextOut( HDC, int, int, LPCSTR, int, int, int __far *, int );
COLORREF __far __pascal GetSysColor( int );
void __far __pascal     SetSysColors( int, const int __far *, const COLORREF __far * );
int __far __pascal      DrawText( HDC, LPCSTR, int, RECT __far *, UINT );
HBITMAP __far __pascal  LoadBitmap( HINSTANCE, LPCSTR );
typedef struct tagMSG {
    HWND    hwnd;
    UINT    message;
    WPARAM  wParam;
    LPARAM  lParam;
    DWORD   time;
    POINT   pt;
} MSG;
typedef MSG         *PMSG;
typedef MSG __near    *NPMSG;
typedef MSG __far     *LPMSG;
typedef LRESULT (__far __pascal *WNDPROC)( HWND, UINT, WPARAM, LPARAM );
typedef struct tagWNDCLASS {
    UINT        style;
    WNDPROC     lpfnWndProc;
    int         cbClsExtra;
    int         cbWndExtra;
    HINSTANCE   hInstance;
    HICON       hIcon;
    HCURSOR     hCursor;
    HBRUSH      hbrBackground;
    LPCSTR      lpszMenuName;
    LPCSTR      lpszClassName;
} WNDCLASS;
typedef WNDCLASS        *PWNDCLASS;
typedef WNDCLASS __near   *NPWNDCLASS;
typedef WNDCLASS __far    *LPWNDCLASS;
typedef struct tagWINDOWPLACEMENT {
    UINT    length;
    UINT    flags;
    UINT    showCmd;
    POINT   ptMinPosition;
    POINT   ptMaxPosition;
    RECT    rcNormalPosition;
} WINDOWPLACEMENT;
typedef WINDOWPLACEMENT     *PWINDOWPLACEMENT;
typedef WINDOWPLACEMENT __far *LPWINDOWPLACEMENT;
typedef FARPROC WNDENUMPROC;
typedef struct tagPAINTSTRUCT {
    HDC     hdc;
    BOOL    fErase;
    RECT    rcPaint;
    BOOL    fRestore;
    BOOL    fIncUpdate;
    BYTE    rgbReserved[16];
} PAINTSTRUCT;
typedef PAINTSTRUCT         *PPAINTSTRUCT;
typedef PAINTSTRUCT __near    *NPPAINTSTRUCT;
typedef PAINTSTRUCT __far     *LPPAINTSTRUCT;
typedef struct tagMOUSEHOOKSTRUCT {
    POINT pt;
    HWND  hwnd;
    UINT  wHitTestCode;
    DWORD dwExtraInfo;
} MOUSEHOOKSTRUCT;
typedef MOUSEHOOKSTRUCT __far *LPMOUSEHOOKSTRUCT;
typedef FARPROC TIMERPROC;
typedef struct tagCREATESTRUCT {
    void __far    *lpCreateParams;
    HINSTANCE   hInstance;
    HMENU       hMenu;
    HWND        hwndParent;
    int         cy;
    int         cx;
    int         y;
    int         x;
    long        style;
    LPCSTR      lpszName;
    LPCSTR      lpszClass;
    DWORD       dwExStyle;
} CREATESTRUCT;
typedef CREATESTRUCT __far    *LPCREATESTRUCT;
typedef struct tagWINDOWPOS {
    HWND    hwnd;
    HWND    hwndInsertAfter;
    int     x;
    int     y;
    int     cx;
    int     cy;
    UINT    flags;
} WINDOWPOS;
typedef WINDOWPOS __far   *LPWINDOWPOS;
typedef struct tagMINMAXINFO {
    POINT   ptReserved;
    POINT   ptMaxSize;
    POINT   ptMaxPosition;
    POINT   ptMinTrackSize;
    POINT   ptMaxTrackSize;
} MINMAXINFO;
typedef FARPROC PROPENUMPROC;
typedef struct tagNCCALCSIZE_PARAMS {
    RECT            rgrc[3];
    WINDOWPOS __far   *lppos;
} NCCALCSIZE_PARAMS;
typedef NCCALCSIZE_PARAMS __far   *LPNCCALCSIZE_PARAMS;
typedef struct {
    UINT    versionNumber;
    UINT    offset;
} MENUITEMTEMPLATEHEADER;
typedef struct {
    UINT    mtOption;
    UINT    mtID;
    char    mtString[1];
} MENUITEMTEMPLATE;
typedef struct tagCLIENTCREATESTRUCT {
    HMENU   hWindowMenu;
    UINT    idFirstChild;
} CLIENTCREATESTRUCT;
typedef CLIENTCREATESTRUCT __far  *LPCLIENTCREATESTRUCT;
typedef struct tagMDICREATESTRUCT {
    LPCSTR      szClass;
    LPCSTR      szTitle;
    HINSTANCE   hOwner;
    int         x;
    int         y;
    int         cx;
    int         cy;
    DWORD       style;
    LPARAM      lParam;
} MDICREATESTRUCT;
typedef MDICREATESTRUCT __far *LPMDICREATESTRUCT;
typedef FARPROC DLGPROC;
typedef struct tagDRAWITEMSTRUCT {
    UINT    CtlType;
    UINT    CtlID;
    UINT    itemID;
    UINT    itemAction;
    UINT    itemState;
    HWND    hwndItem;
    HDC     hDC;
    RECT    rcItem;
    DWORD   itemData;
} DRAWITEMSTRUCT;
typedef DRAWITEMSTRUCT __near *PDRAWITEMSTRUCT;
typedef DRAWITEMSTRUCT __far  *LPDRAWITEMSTRUCT;
typedef struct tagMEASUREITEMSTRUCT {
    UINT    CtlType;
    UINT    CtlID;
    UINT    itemID;
    UINT    itemWidth;
    UINT    itemHeight;
    DWORD   itemData;
} MEASUREITEMSTRUCT;
typedef MEASUREITEMSTRUCT __near  *PMEASUREITEMSTRUCT;
typedef MEASUREITEMSTRUCT __far   *LPMEASUREITEMSTRUCT;
typedef struct tagDELETEITEMSTRUCT {
    UINT    CtlType;
    UINT    CtlID;
    UINT    itemID;
    HWND    hwndItem;
    DWORD   itemData;
} DELETEITEMSTRUCT;
typedef DELETEITEMSTRUCT __near   *PDELETEITEMSTRUCT;
typedef DELETEITEMSTRUCT __far    *LPDELETEITEMSTRUCT;
typedef struct tagCOMPAREITEMSTRUCT {
    UINT    CtlType;
    UINT    CtlID;
    HWND    hwndItem;
    UINT    itemID1;
    DWORD   itemData1;
    UINT    itemID2;
    DWORD   itemData2;
} COMPAREITEMSTRUCT;
typedef COMPAREITEMSTRUCT __near  *PCOMPAREITEMSTRUCT;
typedef COMPAREITEMSTRUCT __far   *LPCOMPAREITEMSTRUCT;
typedef int (__far __pascal *EDITWORDBREAKPROC)( LPSTR, int, int, int );
typedef FARPROC HOOKPROC;
typedef struct tagCBT_CREATEWND {
    CREATESTRUCT __far    *lpcs;
    HWND                hwndInsertAfter;
} CBT_CREATEWND;
typedef CBT_CREATEWND __far   *LPCBT_CREATEWND;
typedef struct tagCBTACTIVATESTRUCT {
    BOOL    fMouse;
    HWND    hWndActive;
} CBTACTIVATESTRUCT;
typedef struct tagHARDWAREHOOKSTRUCT {
    HWND    hWnd;
    UINT    wMessage;
    WPARAM  wParam;
    LPARAM  lParam;
} HARDWAREHOOKSTRUCT;
typedef struct tagEVENTMSG {
    UINT    message;
    UINT    paramL;
    UINT    paramH;
    DWORD   time;
} EVENTMSG;
typedef EVENTMSG        *PEVENTMSG;
typedef EVENTMSG __near   *NPEVENTMSG;
typedef EVENTMSG __far    *LPEVENTMSG;
typedef struct tagDEBUGHOOKINFO {
    HMODULE hModuleHook;
    LPARAM  reserved;
    LPARAM  lParam;
    WPARAM  wParam;
    int     code;
} DEBUGHOOKINFO;
typedef DEBUGHOOKINFO __far   *LPDEBUGHOOKINFO;
typedef struct tagMULTIKEYHELP {
    UINT    mkSize;
    BYTE    mkKeylist;
    BYTE    szKeyphrase[1];
} MULTIKEYHELP;
typedef struct {
    int     wStructSize;
    int     x;
    int     y;
    int     dx;
    int     dy;
    int     wMax;
    char    rgchMember[2];
} HELPWININFO;
typedef HELPWININFO __near    *PHELPWININFO;
typedef HELPWININFO __far     *LPHELPWININFO;
typedef struct tagDCB {
    BYTE    Id;
    UINT    BaudRate;
    BYTE    ByteSize;
    BYTE    Parity;
    BYTE    StopBits;
    UINT    RlsTimeout;
    UINT    CtsTimeout;
    UINT    DsrTimeout;
    UINT    fBinary         : 1;
    UINT    fRtsDisable     : 1;
    UINT    fParity         : 1;
    UINT    fOutxCtsFlow    : 1;
    UINT    fOutxDsrFlow    : 1;
    UINT    fDummy          : 2;
    UINT    fDtrDisable     : 1;
    UINT    fOutX           : 1;
    UINT    fInX            : 1;
    UINT    fPeChar         : 1;
    UINT    fNull           : 1;
    UINT    fChEvt          : 1;
    UINT    fDtrflow        : 1;
    UINT    fRtsflow        : 1;
    UINT    fDummy2         : 1;
    char    XonChar;
    char    XoffChar;
    UINT    XonLim;
    UINT    XoffLim;
    char    PeChar;
    char    EofChar;
    char    EvtChar;
    UINT    TxDelay;
} DCB;
typedef DCB __far *LPDCB;
typedef struct tagCOMSTAT {
    BYTE    status;
    UINT    cbInQue;
    UINT    cbOutQue;
} COMSTAT;
typedef LRESULT (__far __pascal *DRIVERPROC)( DWORD, HDRVR, UINT, LPARAM, LPARAM );
typedef struct tagDRVCONFIGINFO {
    DWORD   dwDCISize;
    LPCSTR  lpszDCISectionName;
    LPCSTR  lpszDCIAliasName;
} DRVCONFIGINFO;
typedef DRVCONFIGINFO __near  *PDRVCONFIGINFO;
typedef DRVCONFIGINFO __far   *LPDRVCONFIGINFO;
typedef struct tagDRIVERINFOSTRUCT {
    UINT        length;
    HDRVR       hDriver;
    HINSTANCE   hModule;
    char        szAliasName[128];
} DRIVERINFOSTRUCT;
typedef DRIVERINFOSTRUCT __far    *LPDRIVERINFOSTRUCT;
void __far __pascal     AdjustWindowRect( RECT __far *, DWORD, BOOL );
void __far __pascal     AdjustWindowRectEx( RECT __far *, DWORD, BOOL, DWORD );
BOOL __far __pascal     AnyPopup( void );
HDC __far __pascal      BeginPaint( HWND, PAINTSTRUCT __far * );
BOOL __far __pascal     BringWindowToTop( HWND );
HWND __far __pascal     ChildWindowFromPoint( HWND, POINT );
void __far __pascal     ClientToScreen( HWND, POINT __far * );
void __far __pascal     ClipCursor( const RECT __far * );
void __far __pascal     CloseWindow( HWND );
void __far __pascal     CopyRect( RECT __far *, const RECT __far * );
void __far __pascal     CreateCaret( HWND, HBITMAP, int, int );
HCURSOR __far __pascal  CreateCursor( HINSTANCE, int, int, int, int, const void __far *, const void __far * );
HICON __far __pascal    CreateIcon( HINSTANCE, int, int, BYTE, BYTE, const void __far *, const void __far * );
HWND __far __pascal     CreateWindow( LPCSTR, LPCSTR, DWORD, int, int, int, int, HWND, HMENU, HINSTANCE, void __far * );
HWND __far __pascal     CreateWindowEx( DWORD, LPCSTR, LPCSTR, DWORD, int, int, int, int, HWND, HMENU, HINSTANCE, void __far * );
LRESULT __far __pascal  DefWindowProc( HWND, UINT, WPARAM, LPARAM );
void __far __pascal     DestroyCaret( void );
BOOL __far __pascal     DestroyCursor( HCURSOR );
BOOL __far __pascal     DestroyIcon( HICON );
BOOL __far __pascal     DestroyWindow( HWND );
BOOL __far __pascal     DrawIcon( HDC, int, int, HICON );
BOOL __far __pascal     EnableWindow( HWND, BOOL );
void __far __pascal     EndPaint( HWND, const PAINTSTRUCT __far * );
BOOL __far __pascal     EnumChildWindows( HWND, WNDENUMPROC, LPARAM );
int __far __pascal      EnumProps( HWND, PROPENUMPROC );
BOOL __far __pascal     EnumTaskWindows( HTASK, WNDENUMPROC, LPARAM );
BOOL __far __pascal     EnumWindows( WNDENUMPROC, LPARAM );
BOOL __far __pascal     EqualRect( const RECT __far *, const RECT __far * );
int __far __pascal      ExcludeUpdateRgn( HDC, HWND );
HWND __far __pascal     FindWindow( LPCSTR, LPCSTR );
BOOL __far __pascal     FlashWindow( HWND, BOOL );
HWND __far __pascal     GetActiveWindow( void );
int __far __pascal      GetAsyncKeyState( int );
HWND __far __pascal     GetCapture( void );
UINT __far __pascal     GetCaretBlinkTime( void );
void __far __pascal     GetCaretPos( POINT __far * );
BOOL __far __pascal     GetClassInfo( HINSTANCE, LPCSTR, WNDCLASS __far * );
int __far __pascal      GetClassName( HWND, LPSTR, int );
void __far __pascal     GetClientRect( HWND, RECT __far * );
void __far __pascal     GetCursorPos( POINT __far * );
HDC __far __pascal      GetDC( HWND );
HWND __far __pascal     GetDesktopWindow( void );
UINT __far __pascal     GetDoubleClickTime( void );
HWND __far __pascal     GetFocus( void );
int __far __pascal      GetKeyState( int );
void __far __pascal     GetKeyboardState( BYTE __far * );
HWND __far __pascal     GetLastActivePopup( HWND );
HWND __far __pascal     GetNextWindow( HWND, UINT );
HWND __far __pascal     GetParent( HWND );
HANDLE __far __pascal   GetProp( HWND, LPCSTR );
HWND __far __pascal     GetSysModalWindow( void );
HWND __far __pascal     GetTopWindow( HWND );
BOOL __far __pascal     GetUpdateRect( HWND, RECT __far *, BOOL );
int __far __pascal      GetUpdateRgn( HWND, HRGN, BOOL );
HWND __far __pascal     GetWindow( HWND, UINT );
HDC __far __pascal      GetWindowDC( HWND );
long __far __pascal     GetWindowLong( HWND, int );
void __far __pascal     GetWindowRect( HWND, RECT __far * );
HTASK __far __pascal    GetWindowTask( HWND );
int __far __pascal      GetWindowText( HWND, LPSTR, int );
int __far __pascal      GetWindowTextLength( HWND );
WORD __far __pascal     GetWindowWord( HWND, int );
void __far __pascal     HideCaret( HWND );
void __far __pascal     InflateRect( RECT __far *, int, int );
BOOL __far __pascal     IntersectRect( RECT __far *, const RECT __far *, const RECT __far * );
void __far __pascal     InvalidateRect( HWND, const RECT __far *, BOOL );
void __far __pascal     InvalidateRgn( HWND, HRGN, BOOL );
BOOL __far __pascal     IsChild( HWND, HWND );
BOOL __far __pascal     IsIconic( HWND );
BOOL __far __pascal     IsRectEmpty( const RECT __far * );
BOOL __far __pascal     IsWindow( HWND );
BOOL __far __pascal     IsWindowEnabled( HWND );
BOOL __far __pascal     IsWindowVisible( HWND );
BOOL __far __pascal     IsZoomed( HWND );
BOOL __far __pascal     KillTimer( HWND, UINT );
HACCEL __far __pascal   LoadAccelerators( HINSTANCE, LPCSTR );
HCURSOR __far __pascal  LoadCursor( HINSTANCE, LPCSTR );
HICON __far __pascal    LoadIcon( HINSTANCE, LPCSTR );
BOOL __far __pascal     MoveWindow( HWND, int, int, int, int, BOOL );
void __far __pascal     OffsetRect( RECT __far *, int, int );
BOOL __far __pascal     OpenIcon( HWND );
BOOL __far __pascal     PostMessage( HWND, UINT, WPARAM, LPARAM );
void __far __pascal     PostQuitMessage( int );
BOOL __far __pascal     PtInRect( const RECT __far *, POINT );
ATOM __far __pascal     RegisterClass( const WNDCLASS __far * );
UINT __far __pascal     RegisterWindowMessage( LPCSTR );
void __far __pascal     ReleaseCapture( void );
int __far __pascal      ReleaseDC( HWND, HDC );
HANDLE __far __pascal   RemoveProp( HWND, LPCSTR );
void __far __pascal     ScreenToClient( HWND, POINT __far * );
BOOL __far __pascal     ScrollDC( HDC, int, int, const RECT __far *, const RECT __far *, HRGN, RECT __far * );
void __far __pascal     ScrollWindow( HWND, int, int, const RECT __far *, const RECT __far * );
LRESULT __far __pascal  SendMessage( HWND, UINT, WPARAM, LPARAM );
HWND __far __pascal     SetActiveWindow( HWND );
HWND __far __pascal     SetCapture( HWND );
void __far __pascal     SetCaretBlinkTime( UINT );
void __far __pascal     SetCaretPos( int, int );
HCURSOR __far __pascal  SetCursor( HCURSOR );
void __far __pascal     SetCursorPos( int, int );
void __far __pascal     SetDoubleClickTime( UINT );
HWND __far __pascal     SetFocus( HWND );
void __far __pascal     SetKeyboardState( BYTE __far * );
HWND __far __pascal     SetParent( HWND, HWND );
BOOL __far __pascal     SetProp( HWND, LPCSTR, HANDLE );
void __far __pascal     SetRect( RECT __far *, int, int, int, int );
void __far __pascal     SetRectEmpty( RECT __far * );
HWND __far __pascal     SetSysModalWindow( HWND );
UINT __far __pascal     SetTimer( HWND, UINT, UINT, TIMERPROC );
long __far __pascal     SetWindowLong( HWND, int, long );
BOOL __far __pascal     SetWindowPos( HWND, HWND, int, int, int, int, UINT );
void __far __pascal     SetWindowText( HWND, LPCSTR );
WORD __far __pascal     SetWindowWord( HWND, int, WORD );
void __far __pascal     ShowCaret( HWND );
int __far __pascal      ShowCursor( BOOL );
void __far __pascal     ShowOwnedPopups( HWND, BOOL );
BOOL __far __pascal     ShowWindow( HWND, int );
BOOL __far __pascal     SubtractRect( RECT __far *, const RECT __far *, const RECT __far * );
BOOL __far __pascal     SwapMouseButton( BOOL );
BOOL __far __pascal     UnionRect( RECT __far *, const RECT __far *, const RECT __far * );
BOOL __far __pascal     UnregisterClass( LPCSTR, HINSTANCE );
void __far __pascal     UpdateWindow( HWND );
void __far __pascal     ValidateRect( HWND, const RECT __far * );
void __far __pascal     ValidateRgn( HWND, HRGN );
HWND __far __pascal     WindowFromPoint( POINT );
int __far __cdecl   wsprintf( LPSTR, LPCSTR, ... );
int __far __pascal      wvsprintf( LPSTR, LPCSTR, const void __far * );
LRESULT __far __pascal  CallWindowProc( FARPROC, HWND, UINT, WPARAM, LPARAM );
int __far __pascal      GetSystemMetrics( int );
BOOL __far __pascal     CallMsgFilter( MSG __far *, int );
long __far __pascal     DispatchMessage( const MSG __far * );
BOOL __far __pascal     GetInputState( void );
BOOL __far __pascal     GetMessage( MSG __far *, HWND, UINT, UINT );
DWORD __far __pascal    GetMessagePos( void );
long __far __pascal     GetMessageTime( void );
BOOL __far __pascal     InSendMessage( void );
BOOL __far __pascal     PeekMessage( MSG __far *, HWND, UINT, UINT, UINT );
BOOL __far __pascal     PostAppMessage( HTASK, UINT, WPARAM, LPARAM );
void __far __pascal     ReplyMessage( LRESULT );
BOOL __far __pascal     TranslateMessage( const MSG __far * );
BOOL __far __pascal     SetMessageQueue( int );
int __far __pascal      TranslateAccelerator( HWND, HACCEL, MSG __far * );
void __far __pascal     WaitMessage( void );
long __far __pascal     GetClassLong( HWND, int );
WORD __far __pascal     GetClassWord( HWND, int );
long __far __pascal     SetClassLong( HWND, int, long );
WORD __far __pascal     SetClassWord( HWND, int, WORD );
HDWP __far __pascal     BeginDeferWindowPos( int );
HDWP __far __pascal     DeferWindowPos( HDWP, HWND, HWND, int, int, int, int, UINT );
BOOL __far __pascal     EndDeferWindowPos( HDWP );
BOOL __far __pascal     AppendMenu( HMENU, UINT, UINT, LPCSTR );
BOOL __far __pascal     ChangeMenu( HMENU, UINT, LPCSTR, UINT, UINT );
BOOL __far __pascal     CheckMenuItem( HMENU, UINT, UINT );
HMENU __far __pascal    CreateMenu( void );
HMENU __far __pascal    CreatePopupMenu( void );
BOOL __far __pascal     DeleteMenu( HMENU, UINT, UINT );
BOOL __far __pascal     DestroyMenu( HMENU );
void __far __pascal     DrawMenuBar( HWND );
BOOL __far __pascal     EnableMenuItem( HMENU, UINT, UINT );
HMENU __far __pascal    GetMenu( HWND );
DWORD __far __pascal    GetMenuCheckMarkDimensions( void );
int __far __pascal      GetMenuItemCount( HMENU );
UINT __far __pascal     GetMenuItemID( HMENU, int );
UINT __far __pascal     GetMenuState( HMENU, UINT, UINT );
int __far __pascal      GetMenuString( HMENU, UINT, LPSTR, int, UINT );
HMENU __far __pascal    GetSubMenu( HMENU, int );
HMENU __far __pascal    GetSystemMenu( HWND, BOOL );
BOOL __far __pascal     HiliteMenuItem( HWND, HMENU, UINT, UINT );
BOOL __far __pascal     InsertMenu( HMENU, UINT, UINT, UINT, LPCSTR );
HMENU __far __pascal    LoadMenu( HINSTANCE, LPCSTR );
HMENU __far __pascal    LoadMenuIndirect( const void __far * );
BOOL __far __pascal     ModifyMenu( HMENU, UINT, UINT, UINT, LPCSTR );
BOOL __far __pascal     RemoveMenu( HMENU, UINT, UINT );
BOOL __far __pascal     SetMenu( HWND, HMENU );
BOOL __far __pascal     SetMenuItemBitmaps( HMENU, UINT, UINT, HBITMAP, HBITMAP );
BOOL __far __pascal     TrackPopupMenu( HMENU, UINT, int, int, int, HWND, const RECT __far * );
BOOL __far __pascal     EnableScrollBar( HWND, int, UINT );
int __far __pascal      GetScrollPos( HWND, int );
void __far __pascal     GetScrollRange( HWND, int, int __far *, int __far * );
int __far __pascal      SetScrollPos( HWND, int, int, BOOL );
void __far __pascal     SetScrollRange( HWND, int, int, int, BOOL );
void __far __pascal     ShowScrollBar( HWND, int, BOOL );
BOOL __far __pascal     ChangeClipboardChain( HWND, HWND );
BOOL __far __pascal     CloseClipboard( void );
int __far __pascal      CountClipboardFormats( void );
BOOL __far __pascal     EmptyClipboard( void );
UINT __far __pascal     EnumClipboardFormats( UINT );
HANDLE __far __pascal   GetClipboardData( UINT );
int __far __pascal      GetClipboardFormatName( UINT, LPSTR, int );
HWND __far __pascal     GetClipboardOwner( void );
HWND __far __pascal     GetClipboardViewer( void );
int __far __pascal      GetPriorityClipboardFormat( UINT __far *, int );
BOOL __far __pascal     IsClipboardFormatAvailable( UINT );
BOOL __far __pascal     OpenClipboard( HWND );
UINT __far __pascal     RegisterClipboardFormat( LPCSTR );
HANDLE __far __pascal   SetClipboardData( UINT, HANDLE );
HWND __far __pascal     SetClipboardViewer( HWND );
void __far __pascal     MessageBeep( UINT );
int __far __pascal      MessageBox( HWND, LPCSTR, LPCSTR, UINT );
UINT __far __pascal     ArrangeIconicWindows( HWND );
LRESULT __far __pascal  DefFrameProc( HWND, HWND, UINT, WPARAM, LPARAM );
LRESULT __far __pascal  DefMDIChildProc( HWND, UINT, WPARAM, LPARAM );
BOOL __far __pascal     TranslateMDISysAccel( HWND, MSG __far * );
void __far __pascal     CheckDlgButton( HWND, int, UINT );
void __far __pascal     CheckRadioButton( HWND, int, int, int );
HWND __far __pascal     CreateDialog( HINSTANCE, LPCSTR, HWND, DLGPROC );
HWND __far __pascal     CreateDialogIndirect( HINSTANCE, const void __far *, HWND, DLGPROC );
HWND __far __pascal     CreateDialogIndirectParam( HINSTANCE, const void __far *, HWND, DLGPROC, LPARAM );
HWND __far __pascal     CreateDialogParam( HINSTANCE, LPCSTR, HWND, DLGPROC, LPARAM );
LRESULT __far __pascal  DefDlgProc( HWND, UINT, WPARAM, LPARAM );
int __far __pascal      DialogBox( HINSTANCE, LPCSTR, HWND, DLGPROC );
int __far __pascal      DialogBoxIndirect( HINSTANCE, HGLOBAL, HWND, DLGPROC );
int __far __pascal      DialogBoxIndirectParam( HINSTANCE, HGLOBAL, HWND, DLGPROC, LPARAM );
int __far __pascal      DialogBoxParam( HINSTANCE, LPCSTR, HWND, DLGPROC, LPARAM );
int __far __pascal      DlgDirList( HWND, LPSTR, int, int, UINT );
int __far __pascal      DlgDirListComboBox( HWND, LPSTR, int, int, UINT );
BOOL __far __pascal     DlgDirSelect( HWND, LPSTR, int );
BOOL __far __pascal     DlgDirSelectComboBox( HWND, LPSTR, int );
void __far __pascal     EndDialog( HWND, int );
DWORD __far __pascal    GetDialogBaseUnits( void );
int __far __pascal      GetDlgCtrlID( HWND );
HWND __far __pascal     GetDlgItem( HWND, int );
UINT __far __pascal     GetDlgItemInt( HWND, int, BOOL __far *, BOOL );
int __far __pascal      GetDlgItemText( HWND, int, LPSTR, int );
HWND __far __pascal     GetNextDlgGroupItem( HWND, HWND, BOOL );
HWND __far __pascal     GetNextDlgTabItem( HWND, HWND, BOOL );
UINT __far __pascal     IsDlgButtonChecked( HWND, int );
void __far __pascal     MapDialogRect( HWND, RECT __far * );
LRESULT __far __pascal  SendDlgItemMessage( HWND, int, UINT, WPARAM, LPARAM );
void __far __pascal     SetDlgItemInt( HWND, int, UINT, BOOL );
void __far __pascal     SetDlgItemText( HWND, int, LPCSTR );
BOOL __far __pascal     IsDialogMessage( HWND, MSG __far * );
BOOL __far __pascal     EnableHardwareInput( BOOL );
BOOL __far __pascal     UnhookWindowsHook( int, HOOKPROC );
LRESULT __far __pascal  DefHookProc( int, WPARAM, LPARAM, HOOKPROC __far * );
HOOKPROC __far __pascal SetWindowsHook( int, HOOKPROC );
BOOL __far __pascal     WinHelp( HWND, LPCSTR, UINT, DWORD );
int __far __pascal      BuildCommDCB( LPCSTR, DCB __far * );
int __far __pascal      ClearCommBreak( int );
int __far __pascal      CloseComm( int );
long __far __pascal     EscapeCommFunction( int, int );
int __far __pascal      FlushComm( int, int );
int __far __pascal      GetCommError( int, COMSTAT __far * );
UINT __far __pascal     GetCommEventMask( int, int );
int __far __pascal      GetCommState( int, DCB __far * );
int __far __pascal      OpenComm( LPCSTR, UINT, UINT );
int __far __pascal      ReadComm( int, void __far *, int );
int __far __pascal      SetCommBreak( int );
UINT __far * __far __pascal   SetCommEventMask( int, UINT );
int __far __pascal      SetCommState( const DCB __far * );
int __far __pascal      TransmitCommChar( int, char );
int __far __pascal      UngetCommChar( int, char );
int __far __pascal      WriteComm( int, const void __far *, int );
HCURSOR __far __pascal  CopyCursor( HINSTANCE, HCURSOR );
HICON __far __pascal    CopyIcon( HINSTANCE, HICON );
void __far __pascal     GetClipCursor( RECT __far * );
HCURSOR __far __pascal  GetCursor( void );
HDC __far __pascal      GetDCEx( HWND, HRGN, DWORD );
long __far __pascal     GetSystemDebugState( void );
BOOL __far __pascal     GetWindowPlacement( HWND, WINDOWPLACEMENT __far * );
BOOL __far __pascal     LockInput( HANDLE, HWND, BOOL );
BOOL __far __pascal     LockWindowUpdate( HWND );
void __far __pascal     MapWindowPoints( HWND, HWND, POINT __far *, UINT );
BOOL __far __pascal     RedrawWindow( HWND, const RECT __far *, HRGN, UINT );
int __far __pascal      ScrollWindowEx( HWND, int, int, const RECT __far *, const RECT __far *, HRGN, RECT __far *, UINT );
BOOL __far __pascal     SetWindowPlacement( HWND, const WINDOWPLACEMENT __far * );
BOOL __far __pascal     SystemParametersInfo( UINT, UINT, void __far *, UINT );
LPARAM __far __pascal   GetMessageExtraInfo( void );
DWORD __far __pascal    GetQueueStatus( UINT );
BOOL __far __pascal     QuerySendMessage( HANDLE, HANDLE, HANDLE, LPMSG );
BOOL __far __pascal     IsMenu( HMENU );
HWND __far __pascal     GetOpenClipboardWindow( void );
BOOL __far __pascal     DlgDirSelectEx( HWND, LPSTR, int, int );
BOOL __far __pascal     DlgDirSelectComboBoxEx( HWND, LPSTR, int, int );
LRESULT __far __pascal  CallNextHookEx( HHOOK, int, WPARAM, LPARAM );
HHOOK __far __pascal    SetWindowsHookEx( int, HOOKPROC, HINSTANCE, HTASK );
BOOL __far __pascal     UnhookWindowsHookEx( HHOOK );
BOOL __far __pascal     EnableCommNotification( int, HWND, int, int );
LRESULT __far __pascal  CloseDriver( HDRVR, LPARAM, LPARAM );
LRESULT __far __pascal  DefDriverProc( DWORD, HDRVR, UINT, LPARAM, LPARAM );
BOOL __far __pascal     GetDriverInfo( HDRVR, DRIVERINFOSTRUCT __far * );
HINSTANCE __far __pascal    GetDriverModuleHandle( HDRVR );
HDRVR __far __pascal    GetNextDriver( HDRVR, DWORD );
HDRVR __far __pascal    OpenDriver( LPCSTR, LPCSTR, LPARAM );
LRESULT __far __pascal  SendDriverMessage( HDRVR, UINT, LPARAM, LPARAM );
void __far __pascal         CloseSound( void );
int __far __pascal          CountVoiceNotes( int );
int __far * __far __pascal    GetThresholdEvent( void );
int __far __pascal          GetThresholdStatus( void );
int __far __pascal          OpenSound( void );
int __far __pascal          StartSound( void );
int __far __pascal          StopSound( void );
int __far __pascal          SetSoundNoise( int, int );
int __far __pascal          SetVoiceAccent( int, int, int, int, int );
int __far __pascal          SetVoiceEnvelope( int, int, int );
int __far __pascal          SetVoiceNote( int, int, int, int );
int __far __pascal          SetVoiceQueueSize( int, int );
int __far __pascal          SetVoiceSound( int, DWORD, int );
int __far __pascal          SetVoiceThreshold( int, int );
int __far __pascal          SyncAllVoices( void );
int __far __pascal          WaitSoundState( int );
    #pragma pack( pop )

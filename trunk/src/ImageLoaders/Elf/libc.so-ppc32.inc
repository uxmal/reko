typedef struct _iob FILE;
typedef struct _io_iob _IO_FILE;
typedef void (*sighandler_t)(int);
typedef __int64 off64_t;
struct timespec
{
	long	tv_sec;
	long	tv_nsec;
};
typedef int clockid_t;

int scanf(char * format, ...);
int printf(char * format, ...);
void free(void * p);
void * malloc(size_t size);
size_t strlen(char *);
char * strchr(char *, char);
char * strrchr(char *, char);
void * memcpy(void *, void *, size_t);
int strcmp(char *,char *);
char * dcgettext(char *, char *, int);
void exit(int);
char * getenv(char *);
int fputs(char *, FILE *);
char * fgets(char *, int, FILE *);
int strncasecmp(char *, char *, int n);
int strcasecmp(char *, char *);
int strncpy(char *, char *, int n);
int fcntl(int fd, int cmd);
void * calloc(size_t num, size_t size);
void abort();
int open(char * filename, int oflag);
int open64(char * filename, int oflag);
FILE * fopen64(char * filename, char * mode);
FILE* fdopen(int fd, char * mode);
sighandler_t signal(int signal, sighandler_t handler);
int close(int);
void * realloc(void *, size_t);
int clock_gettime(clockid_t, struct timespec *);
long sysconf(int name);
void * memset(void *, int value, size_t num);
int fflush(FILE * fp);
char * strtok(char * str, const char * delimiters);
char * strcpy(char * dst, char * src);
int  strncmp(char * dst, char * src, int n);
int fclose(FILE * fp);
int read(int fd, void * buf, size_t count);
int strtol(char * s);
int socket(int dom, int type, int proto);
int feof(FILE * fp);
int unlink(char * path);
char * strerror ( int errnum );
int mkdir(char *path,int);
size_t fread ( void * ptr, size_t size, size_t count, FILE * stream );
size_t fwrite (  void * ptr, size_t size, size_t count, FILE * stream );
int __printf_chk(int flag, const char * format);
int __fprintf_chk(FILE *, int flag, const char * format);
int __sprintf_chk(char * str, int flag, size_t strlen, const char * format);
int __snprintf_chk(char * str, size_t maxlen, int flag, size_t strlen, const char * format);
int * __errno_location();
void __assert_fail(const char * assertion, const char * file, unsigned int line, const char * function);
char * strpbrk(char *, char *);
int fileno(FILE*);
void * __rawmemchr(const void * s, int c);
void __stack_chk_fail(void);
int _IO_putc(int __c, _IO_FILE * __fp);
void *mmap64(void *addr, size_t len, int prot, int flags, int fildes, off64_t off);
